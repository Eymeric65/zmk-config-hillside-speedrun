## boards/shields/hillside_speedrun/Kconfig.defconfig
```kconfig
# Copyright (c) 2020 The ZMK Contributors
# SPDX-License-Identifier: MIT

if SHIELD_HILLSIDE_SPEEDRUN_LEFT

config ZMK_KEYBOARD_NAME
    default "Eymeric keyboard"

config ZMK_SPLIT_ROLE_CENTRAL
    default y

endif

if SHIELD_HILLSIDE_SPEEDRUN_LEFT || SHIELD_HILLSIDE_SPEEDRUN_RIGHT

config ZMK_SPLIT
    default y

endif
```

## boards/shields/hillside_speedrun/Kconfig.shield
```kconfig
# Copyright (c) 2020 The ZMK Contributors
# SPDX-License-Identifier: MIT

config SHIELD_HILLSIDE_SPEEDRUN_LEFT
    def_bool $(shields_list_contains,hillside_speedrun_left)

config SHIELD_HILLSIDE_SPEEDRUN_RIGHT
    def_bool $(shields_list_contains,hillside_speedrun_right)
```
